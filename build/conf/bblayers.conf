## build/conf/bblayers.conf
```bitbake
# LAYER_CONF_VERSION is increased each time build/conf/bblayers.conf
# changes incompatibly
LCONF_VERSION = "8"

BBPATH = "${TOPDIR}"
BBFILES ?= ""

BBLAYERS ?= " \
  /home/roly/openbmc1/meta \
  /home/roly/openbmc1/meta-poky \
  /home/roly/openbmc1/meta-openembedded/meta-oe \
  /home/roly/openbmc1/meta-openembedded/meta-networking \
  /home/roly/openbmc1/meta-openembedded/meta-python \
  /home/roly/openbmc1/meta-openembedded/meta-webserver \
  /home/roly/openbmc1/meta-phosphor \
  /home/roly/openbmc1/meta-raspberrypi \
  /home/roly/openbmc1/meta-evb \
  /home/roly/openbmc1/meta-evb/meta-evb-raspberrypi \
  /home/roly/openbmc1/meta-evb/meta-evb-raspberrypi/meta-evb-raspberrypi3 \
  "
BBLAYERS_NON_REMOVABLE ?= " \
  /home/roly/openbmc1/meta \
  /home/roly/openbmc1/meta-poky \
  /home/roly/openbmc1/meta-openembedded/meta-oe \
  /home/roly/openbmc1/meta-openembedded/meta-networking \
  /home/roly/openbmc1/meta-openembedded/meta-python \
  /home/roly/openbmc1/meta-openembedded/meta-webserver \
  /home/roly/openbmc1/meta-phosphor \
  /home/roly/openbmc1/meta-raspberrypi \
  /home/roly/openbmc1/meta-evb \
  /home/roly/openbmc1/meta-evb/meta-evb-raspberrypi \
  /home/roly/openbmc1/meta-evb/meta-evb-raspberrypi/meta-evb-raspberrypi3 \
  "
```

## meta-evb/conf/layer.conf
```bitbake
# We have a conf and classes directory, add to BBPATH
BBPATH .= ":${LAYERDIR}"

BBFILE_COLLECTIONS += "evb"
BBFILE_PATTERN_evb = ""
LAYERSERIES_COMPAT_evb = "thud"

# Provide a variable that points the base of the evb layer.
EVBBASE = '${@os.path.normpath("${LAYERDIR}/")}'
```

## meta-evb/meta-evb-raspberrypi/conf/layer.conf
```bitbake
# We have a conf and classes directory, add to BBPATH
BBPATH .= ":${LAYERDIR}"

# We have a recipes directory, add to BBFILES
BBFILES += "${LAYERDIR}/recipes*/*/*.bb \
            ${LAYERDIR}/recipes*/*/*.bbappend \
            ${LAYERDIR}/images/*.bb"

BBFILE_COLLECTIONS += "evb-raspberrypi"
BBFILE_PATTERN_evb-raspberrypi := "^${LAYERDIR}/"
LAYERSERIES_COMPAT_evb-raspberrypi = "thud"
BBFILE_PRIORITY_evb-raspberrypi = "11"
```

## meta-evb/meta-evb-raspberrypi/meta-evb-raspberrypi3/conf/bblayers.conf.sample
```bitbake
# LAYER_CONF_VERSION is increased each time build/conf/bblayers.conf
# changes incompatibly
LCONF_VERSION = "8"

BBPATH = "${TOPDIR}"
BBFILES ?= ""

BBLAYERS ?= " \
  ##OEROOT##/meta \
  ##OEROOT##/meta-poky \
  ##OEROOT##/meta-openembedded/meta-oe \
  ##OEROOT##/meta-openembedded/meta-networking \
  ##OEROOT##/meta-openembedded/meta-python \
  ##OEROOT##/meta-openembedded/meta-webserver \
  ##OEROOT##/meta-phosphor \
  ##OEROOT##/meta-raspberrypi \
  ##OEROOT##/meta-evb \
  ##OEROOT##/meta-evb/meta-evb-raspberrypi \
  ##OEROOT##/meta-evb/meta-evb-raspberrypi/meta-evb-raspberrypi3 \
  "
BBLAYERS_NON_REMOVABLE ?= " \
  ##OEROOT##/meta \
  ##OEROOT##/meta-poky \
  ##OEROOT##/meta-openembedded/meta-oe \
  ##OEROOT##/meta-openembedded/meta-networking \
  ##OEROOT##/meta-openembedded/meta-python \
  ##OEROOT##/meta-openembedded/meta-webserver \
  ##OEROOT##/meta-phosphor \
  ##OEROOT##/meta-raspberrypi \
  ##OEROOT##/meta-evb \
  ##OEROOT##/meta-evb/meta-evb-raspberrypi \
  ##OEROOT##/meta-evb/meta-evb-raspberrypi/meta-evb-raspberrypi3 \
  "
```

## meta-evb/meta-evb-raspberrypi/meta-evb-raspberrypi3/conf/layer.conf
```bitbake
# We have a conf and classes directory, add to BBPATH
BBPATH .= ":${LAYERDIR}"

# We have a recipes directory, add to BBFILES
BBFILES += "${LAYERDIR}/recipes*/*/*.bb \
            ${LAYERDIR}/recipes*/*/*.bbappend \
            ${LAYERDIR}/images/*.bb"

BBFILE_COLLECTIONS += "evb-raspberrypi3"
BBFILE_PATTERN_evb-raspberrypi3 = ""
LAYERSERIES_COMPAT_evb-raspberrypi3 = "thud"
```

## meta-evb/meta-evb-raspberrypi/meta-evb-raspberrypi3/conf/local.conf.sample
```bitbake
MACHINE = "raspberrypi3"
DISTRO ?= "openbmc-phosphor"
PACKAGE_CLASSES ?= "package_rpm"
SANITY_TESTED_DISTROS_append ?= " *"
EXTRA_IMAGE_FEATURES = "debug-tweaks"
USER_CLASSES ?= "buildstats image-mklibs image-prelink"
PATCHRESOLVE = "noop"
BB_DISKMON_DIRS = "\
    STOPTASKS,${TMPDIR},1G,100K \
    STOPTASKS,${DL_DIR},1G,100K \
    STOPTASKS,${SSTATE_DIR},1G,100K \
    STOPTASKS,/tmp,100M,100K \
    ABORT,${TMPDIR},100M,1K \
    ABORT,${DL_DIR},100M,1K \
    ABORT,${SSTATE_DIR},100M,1K \
    ABORT,/tmp,10M,1K"
CONF_VERSION = "1"

IMAGE_FSTYPES += "ext4 tar.xz"
KERNEL_IMAGETYPE_UBOOT = "zImage"
KERNEL_BOOTCMD = "bootz"
FDTFILE = "bcm2710-rpi-3-b.dtb"
RPI_UBOOT_CMD = "earlyprintk console=ttyAMA0 console=tty1 root=/dev/mmcblk0p2 rootfstype=ext4 rootwait"
DTOVERLAY = "pi3-disable-bt"
KERNEL_FILE = "zImage"
ENABLE_UART = "1"
DISABLE_SPLASH = "1"
ENABLE_I2C = "1"

FDT_LOAD_ADDR = "0x02000000"

# Set the root password to '0penBmc'
INHERIT += "extrausers"
EXTRA_USERS_PARAMS = " \
  usermod -p '\$1\$UGMqyqdG\$FZiylVFmRRfl9Z0Ue8G7e/' root; \
  "
KERNEL_FEATURES_remove = "phosphor-gpio-keys"

# Overwrite flash offsets
FLASH_UBOOT_OFFSET = "0"
FLASH_KERNEL_OFFSET = "12288"
FLASH_UBI_OFFSET = "${FLASH_KERNEL_OFFSET}"
FLASH_ROFS_OFFSET = "65024"
FLASH_RWFS_OFFSET = "122880"
FLASH_SIZE = "3817472"

require conf/machine/include/obmc-bsp-common.inc

PREFERRED_PROVIDER_virtual/kernel = "linux-raspberrypi"
PREFERRED_VERSION_linux-raspberrypi = "4.18+git%"
```
